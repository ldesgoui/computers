## corne/boards/shields/corne/Kconfig.defconfig
```kconfig
if SHIELD_CORNE_DONGLE

config ZMK_KEYBOARD_NAME
    default "Corne"

config ZMK_SPLIT_ROLE_CENTRAL
    default y

endif

if SHIELD_CORNE_DONGLE || SHIELD_CORNE_P_LEFT || SHIELD_CORNE_P_RIGHT

config ZMK_SPLIT
    default y

endif
```

## corne/boards/shields/corne/Kconfig.shield
```kconfig
config SHIELD_CORNE_DONGLE
    def_bool $(shields_list_contains,corne_dongle)

config SHIELD_CORNE_P_LEFT
    def_bool $(shields_list_contains,corne_p_left)

config SHIELD_CORNE_P_RIGHT
    def_bool $(shields_list_contains,corne_p_right)
```
